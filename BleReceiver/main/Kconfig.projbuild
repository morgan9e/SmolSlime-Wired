## BleReceiver/main/Kconfig.projbuild
```kconfig
menu "SlimeVR BLE receiver"

config SLIME_XIAO_C6_ANTENNA
    bool "Seeed XIAO ESP32-C6: RF switch (onboard / U.FL antenna)"
    depends on IDF_TARGET_ESP32C6
    help
        The XIAO ESP32-C6 routes its radio through an RF switch: GPIO3 low powers it, GPIO14 picks
        the antenna (low: the onboard ceramic one, high: the U.FL connector). Without this the
        radio stays on the onboard antenna whatever is plugged in. The receiver starts on the U.FL
        antenna; console N 0 / N 1 switches (main.c).

endmenu
```

## src/Hub/main/Kconfig.projbuild
```kconfig
menu "Slime Hub"

choice HUB_INPUT
	prompt "Tracker input"
	default HUB_INPUT_WIRED if IDF_TARGET_ESP32S3
	default HUB_INPUT_RECEIVER
	help
		Where the tracker data comes from.

	config HUB_INPUT_RECEIVER
		bool "nRF receiver UART mirror (trackers over radio)"

	config HUB_INPUT_WIRED
		bool "Wired tracker chains (no receiver, no radio)"
		help
			Trackers in wired chain mode send upstream over UART; each chain
			ends on one RX pin of the hub. Trackers are told apart by the
			address in their frames, so nothing needs pairing.
endchoice

menu "Wired chains"
	depends on HUB_INPUT_WIRED

	config HUB_WIRED_CHAINS
		int "Number of chains"
		default 3 if IDF_TARGET_ESP32S3
		default 2
		range 1 3
		help
			One UART per chain. The ESP32-C6 has two, the ESP32-S3 three.

	config HUB_WIRED_BAUD
		int "Baud rate"
		default 460800

	config HUB_WIRED_CHAIN1_RX_GPIO
		int "Chain 1 RX GPIO"
		default 44 if IDF_TARGET_ESP32S3
		default 17 if IDF_TARGET_ESP32C6
		default 5
		help
			XIAO pin D7: GPIO44 on the ESP32-S3, GPIO17 on the ESP32-C6.

	config HUB_WIRED_CHAIN2_RX_GPIO
		int "Chain 2 RX GPIO"
		default 7 if IDF_TARGET_ESP32S3
		default 19 if IDF_TARGET_ESP32C6
		default 6
		help
			XIAO pin D8: GPIO7 on the ESP32-S3, GPIO19 on the ESP32-C6.

	config HUB_WIRED_CHAIN3_RX_GPIO
		int "Chain 3 RX GPIO"
		default 8 if IDF_TARGET_ESP32S3
		default 20 if IDF_TARGET_ESP32C6
		default 7
		help
			XIAO pin D9: GPIO8 on the ESP32-S3. Unused on the ESP32-C6 (two UARTs).
endmenu

menu "Receiver UART"
	depends on HUB_INPUT_RECEIVER

	config HUB_UART_PORT
		int "UART port number"
		default 1
		range 0 2
		help
			UART peripheral used to read the receiver's mirror stream.
			Keep it off the console UART.

	config HUB_UART_RX_GPIO
		int "RX GPIO"
		default 17 if IDF_TARGET_ESP32C6
		default 44 if IDF_TARGET_ESP32S3
		default 5
		help
			GPIO wired to the receiver's TX pin (P0.08, D0 on the ProMicro).
			Pin D7 (labelled RX) on the Seeed XIAO boards:
			GPIO17 on the XIAO ESP32-C6, GPIO44 on the XIAO ESP32-S3.

	config HUB_UART_BAUD
		int "Baud rate"
		default 1000000
endmenu

menu "Wi-Fi"
	config HUB_WIFI_SSID
		string "Default SSID"
		default ""
		help
			Used only when no SSID has been stored with the console "wifi" command.

	config HUB_WIFI_PASSWORD
		string "Default password"
		default ""

	config HUB_WIFI_MAX_TX_POWER_DBM
		int "Maximum TX power in dBm (0 = driver default)"
		default 0
		range 0 20
		help
			Lowering this can reduce interference with the ESB receiver beside the ESP32.
endmenu

menu "SlimeVR"
	config HUB_SERVER_PORT
		int "SlimeVR server UDP port"
		default 6969

	config HUB_LOCAL_PORT_BASE
		int "First local UDP port (tracker id 0)"
		default 6980
		help
			Tracker id n uses local port BASE + n, so the server sees a stable
			address for each tracker across Wi-Fi reconnects.

	config HUB_MAX_TRACKERS
		int "Maximum tracker ids"
		default 16
		range 1 24
		help
			Receiver ids at or above this are ignored. Each id uses one UDP socket.

	config HUB_REPORT_BOARD
		int "Board type reported in the handshake"
		default 4
		help
			4 is CUSTOM in the SlimeVR server, which never offers firmware updates.

	config HUB_SERVER_TIMEOUT_MS
		int "Server silence before re-handshake (ms)"
		default 5000

	config HUB_DROP_MS
		int "Tracker silence before the server link is dropped (ms)"
		default 30000
		help
			After this, the tracker re-handshakes when its data returns.
endmenu

menu "Board"
	config HUB_LED_GPIO
		int "Status LED GPIO (-1 = none)"
		default 15 if IDF_TARGET_ESP32C6
		default 21 if IDF_TARGET_ESP32S3
		default -1
		help
			User LED: GPIO15 on the XIAO ESP32-C6, GPIO21 on the XIAO ESP32-S3.

	config HUB_LED_ACTIVE_LOW
		bool "Status LED is active low"
		default y

	config HUB_BATT_ADC
		bool "Measure hub battery voltage with an ADC divider"
		default n
		help
			Wire two equal resistors (e.g. 220 kOhm each) from BAT+ to GND with
			the midpoint on the ADC GPIO below.

	config HUB_BATT_ADC_GPIO
		int "Battery ADC GPIO"
		depends on HUB_BATT_ADC
		default 0 if IDF_TARGET_ESP32C6
		default 1 if IDF_TARGET_ESP32S3
		default 0
		help
			Pin A0/D0: GPIO0 on the XIAO ESP32-C6, GPIO1 on the XIAO ESP32-S3.

	config HUB_BATT_DIVIDER_X1000
		int "Divider ratio x1000 (battery volts / pin volts)"
		depends on HUB_BATT_ADC
		default 2000

	config HUB_XIAO_C6_RF_SWITCH
		bool "Seeed XIAO ESP32-C6 antenna switch"
		depends on IDF_TARGET_ESP32C6
		default y
		help
			The XIAO ESP32-C6 routes the radio through an RF switch: GPIO3 low
			enables it and GPIO14 selects the antenna. Arduino does this in the
			board variant; under ESP-IDF the hub does it at boot.
			Turn off for other ESP32-C6 boards.

	config HUB_XIAO_C6_EXTERNAL_ANTENNA
		bool "Use the U.FL external antenna instead of the built-in one"
		depends on HUB_XIAO_C6_RF_SWITCH
		default n
endmenu

endmenu
```
