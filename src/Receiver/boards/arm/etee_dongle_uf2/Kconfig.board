## src/Receiver/boards/arm/etee_dongle_uf2/Kconfig.board
```kconfig
# Copyright (c) 2024 Nordic Semiconductor ASA
# SPDX-License-Identifier: Apache-2.0

config BOARD_ETEE_DONGLE_UF2
	bool "etee_dongle_uf2"
	select SOC_DCDC_NRF52X
	depends on SOC_NRF52840_QIAA
```

## src/Receiver/boards/arm/etee_dongle_uf2/Kconfig.defconfig
```kconfig
# Copyright (c) 2024 Nordic Semiconductor ASA
# SPDX-License-Identifier: Apache-2.0

if BOARD_ETEE_DONGLE_UF2

config BOARD
	default "etee_dongle_uf2"

config BT_CTLR
   default BT


endif
```

## src/Receiver/boards/etee/etee_dongle_uf2/board.yml
```yaml
# Copyright (c) 2024 Nordic Semiconductor ASA
# SPDX-License-Identifier: Apache-2.0

board:
  name: etee_dongle_uf2
  vendor: etee
  socs:
    - name: nrf52840
```

## src/Tracker/boards/nordic/test54l/Kconfig.defconfig
```kconfig
if BOARD_TEST54L_NRF54L15_CPUAPP

config BT_CTLR
	default BT

config ROM_START_OFFSET
	default 0x800 if BOOTLOADER_MCUBOOT

endif # BOARD_TEST54L_NRF54L15_CPUAPP
```
